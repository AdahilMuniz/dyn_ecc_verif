/*
 * NASCERR_ImageProcessing.c
 *
 *  Created on: Oct 15, 2024
 *      Author: danal
 */

#include "NASCERR_ImageProcessing.h"

uint8_t image_lesc[148][148] = {{255, 255, 255, 255, 255, 255, 255, 255, 255, 255, 255, 255, 255,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 255, 255},
		{255, 255, 255, 255, 255, 255, 255, 255, 255, 255, 255, 255, 255,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 255, 255},
		{255, 255, 255, 255, 255, 255, 255, 255, 255, 255, 255, 255, 255,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 255, 255},
		{255, 255, 255, 255, 255, 255, 255, 255, 255, 255, 255, 255, 255,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 255, 255},
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		{255, 255, 255, 255, 255, 255, 255, 255, 255, 255, 255, 255, 255,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 255, 255},
};

uint8_t matrix[10][10] = {
		{  12,  95, 233, 108, 190,  67, 212,  43, 174,  34 },
		{  85,  14, 197, 123, 151, 200,  56,  92, 211, 178 },
		{  77, 180,  30,  82,  45, 164,  55,  72,  87,  91 },
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		{ 255,  66, 150,  11, 141, 121, 229, 231,  78,  49 }
};

//uint8_t VETOR_IMG[480000];
uint8_t image_vector[21904];
uint8_t image_stored[21904];
uint8_t image_result[148][148];
uint16_t img_buffer[MEM_SIZE];
uint32_t errors_corrected, total_errors, tick, image_size = 0;
float psnr = 0.0;
ResDescTypeDef result_data[WIDTH*HEIGHT];

NASCERR_RESPONSE nascerr_exp_response;

//TODO: Funções
//Função de integração (recebimento de comando e execução) e função de comparação de imagem


// Função para armazenar a imagem em blocos de 8x8 sequencializados
//void store_image_in_blocks(uint8_t image[768][1024], int width, int height) {
void store_image_in_blocks(int width, int height, uint8_t image[height][width]) {
	if (!is_valid_image_size(width, height)) {
		return;  // Verifica se a imagem tem dimensões válidas
	}

	int block_index = 0;  // Índice para o buffer de saída

	// Percorre a imagem em blocos de 8x8
	for (int i = 0; i < height; i += BLOCK_SIZE) {
		for (int j = 0; j < width; j += BLOCK_SIZE) {
			// Percorre cada bloco de 8x8
			for (int bi = 0; bi < BLOCK_SIZE; bi++) {
				for (int bj = 0; bj < BLOCK_SIZE; bj++) {
					// Armazena o pixel no buffer de saída
					image_vector[block_index++] = image[i + bi][j + bj];
				}
			}
		}
	}
}

//
//void reconstruct_image_from_blocks(uint8_t image[768][1024], int width, int height) {
void reconstruct_image_from_blocks(int width, int height, uint8_t image[height][width]) {
	int block_index = 0;  // Índice para o vetor de entrada

	// Percorre a imagem em blocos de 8x8
	for (int i = 0; i < height; i += BLOCK_SIZE) {
		for (int j = 0; j < width; j += BLOCK_SIZE) {
			// Preenche cada bloco de 8x8 da imagem
			for (int bi = 0; bi < BLOCK_SIZE; bi++) {
				for (int bj = 0; bj < BLOCK_SIZE; bj++) {
					// Recupera o pixel do vetor linear e o armazena na matriz de imagem
					image[i + bi][j + bj] = image_vector[block_index++];
				}
			}
		}
	}
}

// Função que verifica se a imagem tem dimensões múltiplas de 8
int is_valid_image_size(int width, int height) {
	return (width % BLOCK_SIZE == 0 && height % BLOCK_SIZE == 0);
}


//int rle_compress(uint8_t *VETOR_IMG, int input_size, uint8_t *COMPR_IMG) {
//    int i, j = 0;
//
//    for (i = 0; i < input_size; i++) {
//        int count = 1;
//
//        // Conta o número de repetições consecutivas do valor atual
//        while (i < input_size - 1 && VETOR_IMG[i] == VETOR_IMG[i + 1] && count < 255) {
//            count++;
//            i++;
//        }
//
//        // Armazena o valor e o número de repetições no buffer de saída
//        COMPR_IMG[j++] = VETOR_IMG[i];
//        COMPR_IMG[j++] = count;
////        i++;
//    }
//
//    return j; // Retorna o tamanho do buffer comprimido
//}

int rle_compress(uint8_t *input, int size, uint8_t *output) {
	int i = 0;
	int j = 0;

	while (i < size) {
		uint8_t value = input[i];
		uint8_t count = 1;

		// Conta o número de repetições consecutivas do valor atual (até 255, pois usamos uint8_t)
		while (i + 1 < size && input[i] == input[i + 1] && count < 255) {
			count++;
			i++;
		}

		// Armazena o valor e o número de repetições no vetor de saída
		output[j++] = value;
		output[j++] = count;
		i++;
	}

	// Retorna o tamanho do vetor comprimido
	return j;
}

// Função para realizar a descompressão RLE
int rle_decompress(uint8_t *compressed, int compressed_size, uint8_t *decompressed) {
	int i = 0;
	int j = 0;

	// Percorre o vetor comprimido em pares (valor, número de repetições)
	while (i < compressed_size) {
		if(j >= WIDTH *HEIGHT) //estouro de buffer
			return -1; //poderia retornar o valor do buffer (i) em que o algoritmo estava quando ocorreu o estouro
		uint8_t value = compressed[i];
		uint8_t count = compressed[i + 1];

		// Armazena o valor 'count' vezes no vetor de descompressão
		// garantindo que não haverá invasão de espaço crítico de memória
		for (int k = 0; k < count && j < WIDTH * HEIGHT; k++) {
			decompressed[j++] = value;
		}

		i += 2;  // Avança para o próximo par
	}

	// Retorna o tamanho do vetor descomprimido
	return j;
}

// Função para calcular o MSE entre duas imagens
float calculate_mse(int width, int height, uint8_t original[height][width], uint8_t processed[height][width]) {
	float mse = 0.0;
    int i, j;

    for (i = 0; i < height; i++) {
        for (j = 0; j < width; j++) {
            int diff = original[i][j] - processed[i][j];
            mse += diff * diff;
        }
    }

    mse /= (width * height);
    return mse;
}

// Função para calcular o PSNR
float calculate_psnr(int width, int height, uint8_t original[height][width], uint8_t processed[height][width]) {
	float mse = calculate_mse(width, height, original, processed);

    if (mse == 0) {
        return INFINITY;  // PSNR infinito se não houver diferença
    }

    float psnr = 10.0 * log10((255 * 255) / mse);
    return psnr;
}

//
void write_image_blocks(uint8_t *COMPR_IMG, int input_size, NASCERR_MODE ecc, nascerr_rpt repeat) {
	//número de palavras que podem ser escritas por vez = 1024
	//input_size já será o index, número de palavras que nós teremos que escrever
	//a escrita deve levar em consideração o input_size, que será decrementado, e o tamanho máximo da memória, que será o limitante do loop
	uint32_t current_index = 0;

	while (input_size > current_index){
//		uint16_t img_buffer[MEM_SIZE];

		int remaining_bytes = input_size - current_index;
		uint32_t block_size = (remaining_bytes >= MEM_SIZE) ? MEM_SIZE : remaining_bytes;

		for (uint16_t i = 0; i < block_size; i++){
			img_buffer[i] = (uint16_t) *(COMPR_IMG + i + current_index);
		}
		//TODO: CORRIGIR
		//Corrigir a função para função agnóstica aos dados que estão sendo escritos
		for (int i = 0; i < repeat; i++){
			nascerr_memory_write_block_cell(img_buffer, ecc, 0, block_size);
			nascerr_io_delay(1);
			nascerr_memory_read_sram_block(img_buffer, 0, ecc, block_size);
		}


		for (uint16_t i = 0; i < block_size; i++){
			*(COMPR_IMG + i + current_index) = (uint8_t) img_buffer[i];
		}
		current_index += block_size;
	}
}

//
void nascerr_image_processing(NASCERR_CTRL command, int width, int height, uint8_t image[height][width]){
	int tamanho, tamanho_res = 0;
	image_size = 2 * width * height;
	store_image_in_blocks(width, height, image);
	if (command.imagem_exp.compression == LOSSLESS){
		tamanho = rle_compress(image_vector, width * height, image_stored);
		write_image_blocks(image_stored, tamanho, command.mode, command.repeat);
		tamanho_res = rle_decompress(image_stored, tamanho, image_vector);
	}
	if (command.imagem_exp.compression == LOSS_FF){
		tamanho = width * height;
		write_image_blocks(image_vector, tamanho, command.mode, command.repeat);
	}
	if (tamanho_res == -1)
		tamanho_res++; //fazer algo com isso, caso dê erro (pode ser alterar o estado de erro, ou variável de status
	reconstruct_image_from_blocks(width, height, image_result);
	psnr = calculate_psnr(width, height, image, image_result);
	errors_corrected = nascerr_experiment_error_counter_matrix(width, height, image, image_result); //deveria ser 21904
	total_errors = nascerr_experiment_buffer_result_matrix(width, height, image, image_result, result_data); //deveria ser 0
}

//
NASCERR_RESPONSE nascerr_run_experiment(NASCERR_CTRL command){
	//TODO: Funções de Filtro
	//		apply_filter(test_image, width, height);
	int width, height = 0;
	switch (command.imagem_exp.image) {
	case (IMG_0):
			width = 148;
			height = 148;
			tick = HAL_GetTick();
			nascerr_image_processing(command, width, height, image_lesc);
			tick = HAL_GetTick() - tick;
			break;

	case (IMG_1):
			width = 10;
			height = 10;
			tick = HAL_GetTick();
			nascerr_image_processing(command, width, height, matrix);
			tick = HAL_GetTick() - tick;
			break;

	case (IMG_2):
			break;

	case (IMG_FF):
			break;

	default:
			break;

	}

	nascerr_exp_response.id = command.id;
	nascerr_exp_response.data_lenght = command.data_lenght;
	nascerr_exp_response.number_errors = total_errors;
	nascerr_exp_response.corrected_data = errors_corrected;
	nascerr_exp_response.percent_error = psnr; //TODO: corrigir variável para float, sem utilizar o casting
	nascerr_exp_response.result = result_data;

	return nascerr_exp_response;
}
